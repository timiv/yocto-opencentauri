## meta-opencentauri/recipes-bsp/u-boot/files/elegoo_centauri_carbon1_defconfig
```kconfig
CONFIG_ARM=y
CONFIG_ARCH_SUNXI=y
CONFIG_DEFAULT_DEVICE_TREE="elegoo-centauri-carbon1"
CONFIG_SPL=y
CONFIG_MACH_SUN8I_R528=y
CONFIG_DRAM_CLK=792
CONFIG_DRAM_ZQ=8092667
CONFIG_SUNXI_MINIMUM_DRAM_MB=128
# CONFIG_SYS_MALLOC_CLEAR_ON_INIT is not set
CONFIG_DRAM_SUNXI_ODT_EN=0
CONFIG_DRAM_SUNXI_TPR0=0x004a2195
CONFIG_DRAM_SUNXI_TPR11=0x340000
CONFIG_DRAM_SUNXI_TPR12=0x46
CONFIG_DRAM_SUNXI_TPR13=0x34000100
CONFIG_CONS_INDEX=1
#CONFIG_DEBUG_UART=y
#CONFIG_DEBUG_UART_8250=y
#CONFIG_DEBUG_UART_BASE=0x02500000
#CONFIG_DEBUG_UART_CLOCK=24000000
#CONFIG_DEBUG_UART_8250_WORD=y
#CONFIG_DEBUG_UART_8250_SHIFT=2
#CONFIG_DEBUG_UART_ANNOUNCE=y
#CONFIG_USB_HOST=y
CONFIG_USB_EHCI_HCD=y
CONFIG_USB_OHCI_HCD=y
CONFIG_CMD_USB=y
CONFIG_MMC=y
CONFIG_MMC_SUNXI=y
CONFIG_CMD_MMC=y
CONFIG_BOOTDELAY=3
# CONFIG_ENV_IS_IN_FAT is not set
CONFIG_ENV_IS_IN_MMC=y
CONFIG_ENV_OFFSET=0x1A66000
CONFIG_ENV_OFFSET_REDUND=0x1AA5000
CONFIG_ENV_SIZE=0x3F000
CONFIG_SYS_REDUNDAND_ENVIRONMENT=y
CONFIG_ENV_SOURCE_FILE="opencentauri"
CONFIG_USE_BOOTCOMMAND=y
CONFIG_BOOTCOMMAND="run setargs_mmc boot_kernel"

CONFIG_SPL_LOG=y
CONFIG_SPL_LOG_MAX_LEVEL=7
CONFIG_SPL_LOG_CONSOLE=y
CONFIG_SPL_STACK_R_ADDR=0x47e00000
```
